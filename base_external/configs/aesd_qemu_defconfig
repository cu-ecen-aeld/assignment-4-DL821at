## base_external/configs/aesd_qemu_defconfig
```kconfig
BR2_aarch64=y
BR2_KERNEL_HEADERS_6_6=y
BR2_DL_DIR="${HOME}/.dl"
BR2_TARGET_GENERIC_ROOT_PASSWD="root"
BR2_LINUX_KERNEL=y
BR2_LINUX_KERNEL_CUSTOM_TARBALL=y
BR2_LINUX_KERNEL_CUSTOM_TARBALL_LOCATION="https://cdn.kernel.org/pub/linux/kernel/v5.x/linux-5.10.85.tar.xz"
BR2_LINUX_KERNEL_USE_ARCH_DEFAULT_CONFIG=y
BR2_PACKAGE_DHCPCD=y
BR2_PACKAGE_DROPBEAR=y
BR2_PACKAGE_OPENSSH=y
BR2_PACKAGE_SSHPASS=y
BR2_TARGET_ROOTFS_EXT2=y
BR2_TARGET_ROOTFS_EXT2_4=y
BR2_TARGET_ROOTFS_EXT2_SIZE="256M"
BR2_PACKAGE_HOST_PAHOLE=y
BR2_PACKAGE_AESD_ASSIGNMENTS=y
```
